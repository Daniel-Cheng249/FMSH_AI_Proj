# FM33FG0XXA register map
File version: 1.0
CPU: SC000 r1p0, little endian, MPU, no FPU, 3 interrupt priority bits
Registers are 32-bit, read-only, reset 0x0 unless marked. A register's access mark holds for its fields unless they carry their own. Offsets are from the block's base; lines under a group give offsets from that group; [hi:lo] are bit positions; {n}, {i} and the like mark numbered series; 'fields as' and 'values as' point back to an identical list; <NAME> marks a mode.

## Memory map
0x40000000 SCU size 0xC — SCU module information
0x40000000 DBG size 0xC — DBG module information
0x40000400 DMA size 0x4C — DMA module information
0x40000C00 GPIOA size 0x34 — GPIOA module information
0x40000C40 GPIOB size 0x34
0x40000C80 GPIOC size 0x34
0x40000CC0 GPIOD size 0x34
0x40000D00 GPIOE size 0x34
0x40000D40 GPIOF size 0x34
0x40000D80 GPIOG size 0x34
0x40000DC0 GPIOH size 0x34
0x40000E00 GPIOI size 0x34
0x40000E40 GPIO size 0xE0 — GPIO module information
0x40001000 FLS size 0x210 — FLS module information
0x40001C00 SFU size 0x10 — SFU module information
0x40002000 PMU size 0x88 — PMU module information
0x40002400 CMU size 0x88 — CMU module information
0x40002800 RMU size 0x24 — RMU module information
0x40010000 CRC size 0x20 — CRC module information
0x40010400 SPI0 size 0x28 — SPI0 module information
0x40010800 SPI1 size 0x28
0x40011000 RTC size 0x44 — RTC module information
0x40011400 IWDT size 0x18 — IWDT module information
0x40011800 WWDT size 0x18 — WWDT module information
0x40011C00 USART4 size 0x54 — USART4 module information
0x40012000 USART5 size 0x54
0x40012400 I2C0 size 0x24 — I2C0 module information
0x40012800 SVD size 0x14 — SVD module information
0x40013000 ATIM size 0x64 — ATIM module information
0x40013400 LPTIM32 size 0x30 — LPTIM32 module information
0x40013800 AES size 0x54 — AES module information
0x40013C00 RNG size 0x20 — RNG module information
0x40014000 LPUART0 size 0x1C — LPUART0 module information
0x40014400 LPUART1 size 0x1C
0x40014800 SPI2 size 0x28
0x40014C00 GPTIM0 size 0x64 — GPTIM0 module information
0x40015000 LPUART2 size 0x1C
0x40015400 COMP size 0x1C — COMP module information
0x40015800 TAU0 size 0xF0 — TAU0 module information
0x40015800 TAU1 size 0x1F0 — TAU1 module information
0x40015C00 ADC size 0x50 — ADC module information
0x40016000 BSTIM32 size 0x30 — BSTIM32 module information
0x40016400 GPTIM1 size 0x64
0x40016800 UART0 size 0x84 — UART0 module information
0x40016C00 PGL size 0x2C — PGL module information
0x40017000 UART1 size 0x84 — UART1 module information
0x40017400 UART2 size 0x84
0x40017800 UART3 size 0x84
0x40017C00 UART size 0x84 — UART module information
0x40018000 GPTIM2 size 0x64
0x40018400 BSTIM16 size 0x30 — BSTIM16 module information
0x40018800 LPTIM16 size 0x28 — LPTIM16 module information
0x40019000 DAC size 0x1C — DAC module information
0x40019400 HDIV size 0x14 — HDIV module information
0x40019C00 I2C1 size 0x24
0x4001A000 I2CSMB0 size 0x34 — I2CSMB0 module information
0x4001A400 I2CSMB1 size 0x34
0x4001A800 SPI3 size 0x28
0x4001B000 SENT0 size 0x20 — SENT0 module information
0x4001B400 SENT1 size 0x20
0x4001B800 CLM0 size 0x18 — CLM0 module information
0x4001BC00 CLM1 size 0x18
0x40020000 CANFD0 size 0x1780 — CANFD0 module information
0x40024000 CANFD1 size 0x1780 — CANFD1 module information
0x40028000 CAN size 0x110 — CAN module information

## Interrupts
0 WDT (IWDT, WWDT) — WDT interrupt
1 SVD — SVD interrupt
2 RTC — RTC interrupt
3 CANFD0 — CANFD0 interrupt
4 CANFD1 — CANFD1 interrupt
5 ADC — ADC interrupt
7 UART0 — UART0 interrupt
8 UART1 — UART1 interrupt
9 UART2 — UART2 interrupt
10 UART3 — UART3 interrupt
12 I2CMX (I2C0, I2C1) — I2CMX interrupt
13 SPI0 — SPI0 interrupt
14 SPI1 — SPI1 interrupt
15 SPI2 — SPI2 interrupt
16 SPI3 — SPI3 interrupt
17 I2C_SMBX (I2CSMB0, I2CSMB1) — I2C_SMBX interrupt
19 AES — AES interrupt
20 LPTIM_BSTIM (BSTIM32, BSTIM16, LPTIM16) — LPTIM_BSTIM interrupt
21 DMA — DMA interrupt
22 WKUPX (GPIO) — WKUPX interrupt
23 TAU_PGL (TAU0, TAU1, PGL) — TAU_PGL interrupt
24 GPTIMX (GPTIM{n} (n=0..2)) — GPTIMX interrupt
25 COMPX (COMP) — COMPX interrupt
27 NVMIF (FLS) — NVMIF interrupt
28 ATIM — ATIM interrupt
29 LPUART (LPUART1) — LPUART interrupt
30 EXTI_DAC (DAC, GPIO) — EXTI_DAC interrupt
31 ECCC_RAMP_FDET (FLS, CMU) — ECCC_RAMP_FDET interrupt
